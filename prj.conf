## CMakeLists.txt
```
# Copyright 2026 NXP
#
# SPDX-License-Identifier: BSD-3-Clause

cmake_minimum_required(VERSION 3.22.0)
if(NOT DEFINED board OR "${board}" STREQUAL "")
    set(board frdmmcxa153 CACHE STRING "Target board" FORCE)
endif()

cmake_path(APPEND conf_file_path ${CMAKE_CURRENT_LIST_DIR} ${board} prj.conf)
set(CONF_FILE ${conf_file_path} ${CONF_FILE})
include(${SdkRootDirPath}/cmake/extension/mcux.cmake)

project(getting_started LANGUAGES C CXX ASM PROJECT_BOARD_PORT_PATH ${board_root}/${board}/ese_examples/general/getting_started)


include(${board}/board_files.cmake)
include(${SdkRootDirPath}/CMakeLists.txt)


mcux_add_source(
    SOURCES board/board.h
            lib/fifo/fifo.c
            lib/fifo/fifo.h
            lib/leds/leds.c
            lib/leds/leds.h
            lib/serial/retarget.c
            lib/serial/serial.c
            lib/serial/serial.h
            lib/lcd/lcd.c
            lib/lcd/lcd.h
            lib/lpi2c/lpi2c.c
            lib/lpi2c/lpi2c.h
            lib/oled/oled.c
            lib/oled/oled.h
            lib/mpr121/mpr121.c
            lib/mpr121/mpr121.h
            lib/serial2lpuart/lpuart2.c
            lib/serial2lpuart/lpuart2.h

            main.c
            src/states.c
            src/states.h
            src/states/state_init.c
            src/states/state_init.h
            src/states/state_navigation.c
            src/states/state_navigation.h
            src/states/state_game_missions/state_game_missions.h
            src/states/state_game_missions/state_experience_mission.c
            src/states/state_game_missions/state_material_question.c
            src/states/state_game_missions/state_material_collection.c
            src/states/state_game_missions/state_build_test.c
            src/states/state_game_missions/state_finish.c
            src/states/state_menu.c
            src/states/state_menu.h
            src/beacon/beacon_parser.c
            src/beacon/beacon_parser.h
            src/navigation/routes.c
            src/navigation/routes.h
            src/hm10/hm10.c
            src/hm10/hm10.h
            src/helperFunctions.c
            src/helperFunctions.h
            src/keypad.c
            src/keypad.h
            src/game_logger/game_logger.h
            src/game_logger/game_logger.c
            src/game_logger/diskio.h
            src/game_logger/diskio.c
            src/game_logger/ff.h
            src/game_logger/ff.c
            src/game_logger/ffconf.h
)

mcux_add_include(
    INCLUDES .
             board
             lib/fifo
             lib/leds
             lib/serial
             lib/lcd
             lib/lpi2c
             lib/oled
             lib/mpr121
             lib/serial2lpuart
             
             src
             src/game_logger
             src/states
             src/states/state_game_missions
             src/beacon
             src/navigation
             src/hm10
)
mcux_convert_binary(BINARY ${APPLICATION_BINARY_DIR}/${MCUX_SDK_PROJECT_NAME}.bin)

target_compile_definitions(getting_started PRIVATE 
    CPU_MCXA153VLH=1
    MCXA153_SERIES=1
)
```

## Kconfig
```
# It is optional to provide example specific Kconfig.

mainmenu "General - Getting started"

# Need to refer the root Kconfig.mcuxpreso to get all Kconfig data
source "${SdkRootDirPath}/Kconfig.mcuxpresso"

# Board example specific Kconfig can be linked in this way if needed
osource "${SdkRootDirPath}/${project_board_port_path}/Kconfig"
orsource "${board}/Kconfig.trace"
```

## prj.conf
```kconfig
# Copyright 2026 NXP
#
# SPDX-License-Identifier: BSD-3-Clause
CONFIG_MCUX_PRJSEG_module.board.boardfile=n
CONFIG_MCUX_PRJSEG_module.board.board_core_file=n
CONFIG_MCUX_PRJSEG_module.board.console_lite=n
CONFIG_MCUX_PRJSEG_module.board.console=n
CONFIG_MCUX_PRJSEG_module.board.suite=y
CONFIG_MCUX_PRJSEG_module.board.use_board_clock=n
CONFIG_MCUX_HAS_PRJSEG_module.board.pinmux_sel=n
CONFIG_MCUX_HAS_PRJSEG_module.board.peripheral_sel=n
CONFIG_MCUX_HAS_PRJSEG_project.use_hw_app=n
CONFIG_MCUX_COMPONENT_driver.romapi=n
CONFIG_MCUX_COMPONENT_driver.clock=n
CONFIG_MCUX_COMPONENT_driver.edma_soc=n
CONFIG_MCUX_COMPONENT_driver.inputmux_connections=n
CONFIG_MCUX_COMPONENT_driver.reset=n
CONFIG_MCUX_COMPONENT_driver.trdc_soc=n
CONFIG_MCUX_COMPONENT_driver.common=n
CONFIG_MCUX_COMPONENT_driver.gpio=n
CONFIG_MCUX_COMPONENT_driver.lpuart=n
CONFIG_MCUX_COMPONENT_driver.mcx_spc=n
CONFIG_MCUX_COMPONENT_driver.port=n

# BEGIN AUTO-ADDED BY MCUXPRESSO EXTENSION
CONFIG_MCUX_COMPONENT_driver.common=y
CONFIG_MCUX_COMPONENT_driver.glikey=y
# END AUTO-ADDED BY MCUXPRESSO EXTENSION

# BEGIN AUTO-ADDED BY MCUXPRESSO EXTENSION
CONFIG_MCUX_COMPONENT_driver.mcx_cmc=y
CONFIG_MCUX_COMPONENT_driver.mcx_spc=y
CONFIG_MCUX_COMPONENT_driver.port=y
# END AUTO-ADDED BY MCUXPRESSO EXTENSION

# BEGIN AUTO-ADDED BY MCUXPRESSO EXTENSION
CONFIG_MCUX_COMPONENT_driver.clock=y
CONFIG_MCUX_COMPONENT_driver.reset=y
CONFIG_MCUX_COMPONENT_driver.glikey=n
CONFIG_MCUX_COMPONENT_driver.mcx_cmc=n
# END AUTO-ADDED BY MCUXPRESSO EXTENSION
```

## src/helperFunctions.c
```c
#include <board.h>

void setUpPin(PORT_Type *port, int pin, unsigned char output, int pin_config){
    GPIO_Type *gpio;

    if(port == PORT0){
        MRCC0->MRCC_GLB_CC0_SET  |=  MRCC_MRCC_GLB_CC0_PORT0(1);
        MRCC0->MRCC_GLB_CC1_SET  |=  MRCC_MRCC_GLB_CC1_GPIO0(1);
        MRCC0->MRCC_GLB_RST0_SET |=  MRCC_MRCC_GLB_CC0_PORT0(1);
        MRCC0->MRCC_GLB_RST1_SET |=  MRCC_MRCC_GLB_CC1_GPIO0(1);
        gpio = GPIO0;
    }

    if(port == PORT1){
        MRCC0->MRCC_GLB_CC0_SET  |=  MRCC_MRCC_GLB_CC0_PORT1(1);
        MRCC0->MRCC_GLB_CC1_SET  |=  MRCC_MRCC_GLB_CC1_GPIO1(1);
        MRCC0->MRCC_GLB_RST0_SET |=  MRCC_MRCC_GLB_CC0_PORT1(1);
        MRCC0->MRCC_GLB_RST1_SET |=  MRCC_MRCC_GLB_CC1_GPIO1(1);
        gpio = GPIO1;
    }
    
    if(port == PORT2){
        MRCC0->MRCC_GLB_CC0_SET  |=  MRCC_MRCC_GLB_CC0_PORT2(1);
        MRCC0->MRCC_GLB_CC1_SET  |=  MRCC_MRCC_GLB_CC1_GPIO2(1);
        MRCC0->MRCC_GLB_RST0_SET |=  MRCC_MRCC_GLB_CC0_PORT2(1);
        MRCC0->MRCC_GLB_RST1_SET |=  MRCC_MRCC_GLB_CC1_GPIO2(1);
        gpio = GPIO2;
    }

    if(port == PORT3){
        MRCC0->MRCC_GLB_CC1_SET  |=  MRCC_MRCC_GLB_CC1_PORT3(1) | MRCC_MRCC_GLB_CC1_GPIO3(1);
        MRCC0->MRCC_GLB_RST1_SET |=  MRCC_MRCC_GLB_CC1_PORT3(1);
        MRCC0->MRCC_GLB_RST1_SET |=  MRCC_MRCC_GLB_CC1_GPIO3(1);
        gpio = GPIO3;
    }

    port->PCR[pin] |= pin_config ;
    if(output){
        gpio->PDDR |= (1<<pin);
    }
}
```

## src/helperFunctions.h
```c
#ifndef HELPERFUNCTIONS_H
#define HELPERFUNCTIONS_H
#include <board.h>

void setUpPin(PORT_Type *port, int pin, unsigned char output, int pin_config);

#endif
```

## src/keypad.c
```c
#include <MCXA153.h>
#include <board.h>
#include <stdio.h>
#include <stdbool.h>
#include "helperFunctions.h"
#include "keypad.h"
#include "mpr121.h"
#include "states.h"

volatile uint16_t pressedKey;
volatile char keypadFlag;
extern uint16_t touch_reg;
extern uint32_t touch_interrupt_now;
extern uint32_t ms;
extern char handle_touch_interrupt;
extern State_t STATE_BOOT_MENU;

const char* TOUCHPAD_STRINGS[16] = {
    "TWO",    // (1 << 15)
    "FIVE",   // (1 << 14)
    "EIGHT",  // (1 << 13)
    "ENTER",  // (1 << 12)
    "ONE",    // (1 << 11)
    "FOUR",   // (1 << 10)
    "SEVEN",  // (1 << 9)
    "LEFT",   // (1 << 8)
    "UNKNOWN",
    "UNKNOWN",
    "UNKNOWN",
    "UNKNOWN",
    "THREE",  // (1 << 3)
    "SIX",    // (1 << 2)
    "NINE",   // (1 << 1)
    "RIGHT"   // (1 << 0)
};

void initKeypad(){
   // initialize the keypad
   // make sure lpi2c is active
    mpr121_setup();

    keypadFlag = false;
    // set up intterupt pins
    setUpPin(PORT3, 1, 0,  PORT_PCR_LK(1) | PORT_PCR_PE(1) | PORT_PCR_PS(1) | PORT_PCR_IBE(1) | PORT_PCR_MUX(0));

    GPIO3->ICR[1] = GPIO_ICR_ISF(1) | GPIO_ICR_IRQC(0b1010);

    // Enable GPIO3 interrupts
    NVIC_SetPriority(GPIO3_IRQn, 3);
    NVIC_ClearPendingIRQ(GPIO3_IRQn);
    NVIC_EnableIRQ(GPIO3_IRQn);
    getTouchReg();

}

void GPIO3_IRQHandler(void)
{
    // Clear the interrupt
    NVIC_ClearPendingIRQ(GPIO3_IRQn);

    if(GPIO_ISFR_ISF1(1) != 0){
        GPIO3->ISFR[0] = GPIO_ISFR_ISF1(1);

        // Handle the event
        touch_interrupt_now = ms;
        handle_touch_interrupt = true;

        // read the register, the keypad doesn't continue generating interrupts if the register hasn't been read after interrupt
        // Maybe in the future set up a queue to read the register multiple timmes
        // but for now it is good enough.
        getTouchReg();
    }
}

void readKeypad(){
    // read the mpr register
    getTouchReg();

    // plot the touch reg to keys pressed
    // crazy logic:
    if(touch_reg == 0) return;

    // we're going to use a built in function of GCC, Count leading zeros, 
    // it will give back the position of the MSB
    pressedKey = __CLZ(touch_reg) - 16;
    keypadFlag = true;

    printf("proccessing keypress, key: %s \r\n", TOUCHPAD_STRINGS[pressedKey]);
}

void keypadReInit(StateMachine_t *sm){
    mpr121_reconfigure();
    addToQueue(sm, &STATE_BOOT_MENU);
    sm->isBusy = false;
}
```

## src/keypad.h
```c
#ifndef KEYPAD_H
#define KEYPAD_H
#include "states.h"

enum keys {
    TWO,
    FIVE,
    EIGHT,
    ENTER,
    ONE, 
    FOUR,
    SEVEN,
    LEFT,
    ___UNKOWN_KEY_0,
    ___UNKOWN_KEY_1,
    ___UNKOWN_KEY_2,
    ___UNKOWN_KEY_3,
    THREE,
    SIX, 
    NINE,
    RIGHT
};

void initKeypad();
void readKeypad();
void keypadReInit(StateMachine_t *sm);
#endif
```

## src/states.c
```c
#include "states.h"
#include "fifo.h"
#include <stdio.h>

void initStateMachine(StateMachine_t *sm, State_t *firstState){
    sm->state = firstState;
    sm->isBusy = true;

    f_init(&sm->queue, 
              (void*)sm->buffer,            // Point to the internal array
              8,                           // Max items?
              sizeof(const State_t *));     // Size of one pointer

    // Can't print here, serial isn't initialized yet.
    sm->state->entry(sm);

    printf("MAIN %s\r\n", sm->state->name);
    sm->state->main(sm);
}

void addToQueue(StateMachine_t *sm, State_t *newState){
    f_push(&sm->queue, &newState);
}

void updateStateMachine(StateMachine_t *sm){
    const State_t *nextState = NULL;
    // if not busy pop the first fifo, and read the next one if there is a new one, 
    // put this into the newState variable;
    if(!sm->isBusy && f_pop(&sm->queue, &nextState)){
        printf("EXIT %s\r\n", sm->state->name);
        sm->state->exit(sm);
        sm->state = nextState;
        sm->isBusy = true;
        printf("ENTER %s\r\n", sm->state->name);
        sm->state->entry(sm);
        printf("MAIN %s\r\n", sm->state->name);
        return;
    }

    sm->state->main(sm);
}
```

## src/states.h
```c
#include "fifo.h"

#ifndef STATES_H
#define STATES_H

#define QUEUE_CAPACITY 8

// this tells the compiler that StateMachine_t will exist in the future.
typedef struct StateMachine_t StateMachine_t;
typedef struct State_t State_t;

struct State_t {
    void (*entry)(StateMachine_t *sm);
    void (*main)(StateMachine_t *sm);
    void (*exit)(StateMachine_t *sm);
    const char *name;
};

struct StateMachine_t {
    const State_t *state;
    bool isBusy;
    const State_t *buffer[QUEUE_CAPACITY];
    fifo_t queue;
};


void initStateMachine(StateMachine_t *sm, State_t *firstState);
void addToQueue(StateMachine_t *sm, State_t *newState);
void updateStateMachine(StateMachine_t *sm);

#endif
```
